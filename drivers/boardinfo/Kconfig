## drivers/boardinfo/Kconfig
```kconfig
#
# boardinfo drivers
#
# When adding new entries keep the list in alphabetical order

config BOARDINFO
	tristate "tinker boardinfo"
	default n
	help
	  Driver to set board information.
```

## drivers/gpu/drm/bridge/lt9211/Kconfig
```kconfig
config DRM_I2C_LT9211
	tristate "LT9211"
	depends on OF
	select DRM_KMS_HELPER
	select REGMAP_I2C
	help
	  Support for the Lontium LT9211.
```

## drivers/pcie_mhi/Kconfig
```kconfig
config QUECTEL_PCIE
	tristate "Support Quectel's pcie module"
	default n
	help
	  Driver for Quectel's module in pcie mode.
```
