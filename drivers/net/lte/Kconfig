## drivers/net/lte/Kconfig
```kconfig
#
# LTE network device configuration
#

menuconfig LTE
	tristate "Rockchip LTE support"
	help
	Enable LTE drivers for Rockchip platform.

if LTE
config LTE_RM310
	tristate "LTE rm310 support"
	default n

endif
```
